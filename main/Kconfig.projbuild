## main/Kconfig.projbuild
```kconfig
menu "MP65 attitude application"
    config MP65_ATTITUDE_STREAM
        bool "Stream attitude over native USB (UART console required)"
        default n
        help
            Emit quantized quaternion and ready channels through esp_stream
            at 25 Hz from Core 0. Owns native USB;
            cannot run alongside the capture transport or USB console.
            Acquisition never waits for USB. Uses a one-slot overwrite queue.
endmenu
```

## sdkconfig.defaults
```kconfig
CONFIG_ESPTOOLPY_FLASHSIZE_4MB=y
CONFIG_MP65_ATTITUDE_STREAM=y
CONFIG_ESP_CONSOLE_UART_DEFAULT=y
CONFIG_ESP_CONSOLE_SECONDARY_NONE=y
# CONFIG_ESP_CONSOLE_SECONDARY_USB_SERIAL_JTAG is not set
CONFIG_COMPILER_OPTIMIZATION_PERF=y
CONFIG_FREERTOS_HZ=1000
CONFIG_ESP_DEFAULT_CPU_FREQ_MHZ_240=y
# CONFIG_ESP_DEFAULT_CPU_FREQ_MHZ_160 is not set
CONFIG_ESP_DEFAULT_CPU_FREQ_MHZ=240
# CONFIG_ESP32S3_DEFAULT_CPU_FREQ_160 is not set
CONFIG_ESP32S3_DEFAULT_CPU_FREQ_240=y
CONFIG_ESP32S3_DEFAULT_CPU_FREQ_MHZ=240
```
